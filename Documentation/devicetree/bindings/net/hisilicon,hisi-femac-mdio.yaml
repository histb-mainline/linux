## Documentation/devicetree/bindings/net/hisilicon,hisi-femac-mdio.yaml
```yaml
# SPDX-License-Identifier: GPL-2.0-only OR BSD-2-Clause
%YAML 1.2
---
$id: http://devicetree.org/schemas/net/hisilicon,hisi-femac-mdio.yaml#
$schema: http://devicetree.org/meta-schemas/core.yaml#

title: HiSilicon FEMAC MDIO bus

maintainers:
  - Yang Xiwen <forbidden405@formail.com>

allOf:
  - $ref: mdio.yaml#

properties:
  compatible:
    const: hisilicon,hisi-femac-mdio

  reg:
    maxItems: 1

required:
  - compatible
  - reg

unevaluatedProperties: false

examples:
  - |
    mdio@10091100 {
        compatible = "hisilicon,hisi-femac-mdio";
        reg = <0x10091100 0x20>;
        #address-cells = <1>;
        #size-cells = <0>;

        phy@1 {
            reg = <1>;
        };
    };
```

## Documentation/devicetree/bindings/phy/hisilicon,inno-usb2-phy.yaml
```yaml
# SPDX-License-Identifier: (GPL-2.0-only OR BSD-2-Clause)
%YAML 1.2
---
$id: http://devicetree.org/schemas/phy/hisilicon,inno-usb2-phy.yaml#
$schema: http://devicetree.org/meta-schemas/core.yaml#

title: HiSilicon HiSTB SoCs INNO USB2 PHY device

maintainers:
  - Yang Xiwen <forbidden405@outlook.com>

properties:
  compatible:
    items:
      - enum:
          - hisilicon,hi3798cv200-usb2-phy
          - hisilicon,hi3798mv100-usb2-phy
          - hisilicon,hi3798mv200-usb2-phy

  reg:
    maxItems: 1
    description: Should be the address space for PHY configuration register in
      peripheral controller, e.g. PERI_USB0 for USB 2.0 PHY01 on Hi3798CV200 SoC,
      or direct MMIO address space.

  ranges:
    maxItems: 1

  '#address-cells':
    const: 1

  '#size-cells':
    enum: [0, 1]

  clocks:
    maxItems: 1
    description: reference clock

  resets:
    minItems: 1
    items:
      - description: port reset
      - description: optional external test bus reset

  reset-names:
    items:
      - const: port
      - const: test

patternProperties:
  'phy@[0-9a-f]+':
    type: object
    additionalProperties: false
    description: individual ports provided by INNO PHY

    properties:
      reg:
        maxItems: 1
        description: should be the port index (if under a perictrl node)
          or port address space

      '#phy-cells':
        const: 0

      resets:
        maxItems: 1

      phy_type:
        const: utmi

    required:
      - reg
      - '#phy-cells'
      - resets

required:
  - compatible
  - clocks
  - reg
  - '#address-cells'
  - '#size-cells'
  - resets

allOf:
  - if:
      properties:
        compatible:
          contains:
            const: hisilicon,hi3798mv200-usb2-phy
    then:
      required:
        - ranges
        - reset-names
    else:
      properties:
        ranges: false
        reset-names: false

additionalProperties: false

examples:
  - |
    usb2-phy@120 {
        compatible = "hisilicon,hi3798cv200-usb2-phy";
        reg = <0x120 0x4>;
        clocks = <&clk_ref>;
        resets = <&crg 0xbc 4>;
        #address-cells = <1>;
        #size-cells = <0>;

        phy@0 {
            reg = <0>;
            #phy-cells = <0>;
            resets = <&crg 0xbc 8>;
        };

        phy@1 {
            reg = <1>;
            #phy-cells = <0>;
            resets = <&crg 0xbc 9>;
        };
    };
```

## Documentation/devicetree/bindings/pinctrl/hisilicon,hi3798mv200-ioconfig.yaml
```yaml
# SPDX-License-Identifier: (GPL-2.0-only OR BSD-2-Clause)
%YAML 1.2
---
$id: http://devicetree.org/schemas/pinctrl/hisilicon,hi3798mv200-ioconfig.yaml#
$schema: http://devicetree.org/meta-schemas/core.yaml#

title: HiSilicon Hi3798MV200 SoC IOCONFIG module

maintainers:
  - Yang Xiwen <forbidden405@outlook.com>

description: Hi3798MV200 IOCONFIG pinmux&pinconf controller

properties:
  compatible:
    const: hisilicon,hi3798mv200-ioconfig

  reg:
    maxItems: 1

  "#pinctrl-cells":
    const: 1

patternProperties:
  "-state$":
    oneOf:
      - $ref: "#/$defs/hi3798mv200-iocfg-pin-state"
      - patternProperties:
          "-pins?$":
            $ref: "#/$defs/hi3798mv200-iocfg-pin-state"
        unevaluatedProperties: false

$defs:
  hi3798mv200-iocfg-pin-state:
    $ref: hisilicon,histb-pinctrl-common.yaml#/$defs/histb-pin-state
    unevaluatedProperties: false

    properties:
      pins:
        items:
          enum: [ Y19, W19, AA20, Y20, V19, Y21, W20, W21, V20, V21, U20, U21,
                  T18, T19, T20, R20, R21, P20, R19, K18, J17, J18, H17, H18, K20,
                  K19, J20, J19, H21, H20, H19, G20, G19, F21, F20, F19, E20, E19,
                  D21, E18, C20, D19, B21, B18, C17, B17, A17, C16, B16, B4, C4, A3,
                  B3, A2, B2, A6, C6, C5, C3, D4, D3, B1, C2, C1, A5, D5 ]

      function:
        enum: [ gpio, bootsel, clkout, emmc, fe_led, hdmitx, i2c_scl, i2c_sda,
                i2s_clk, i2s_data, i2s_ws, jtag, nand, pmc, rgmii, rmii, sata, sdio,
                sim, spdif, spi, spi_flash, tsi0_d0, tsi0_d1, tsi0_data, tsi1_data,
                tsi2_data, tsi3_data, tso, tsi_clk, tsi_sync, tsi_valid, uart ]

allOf:
  - $ref: hisilicon,histb-pinctrl-common.yaml#

required:
  - compatible
  - reg

unevaluatedProperties: false
```

## Documentation/devicetree/bindings/pinctrl/hisilicon,histb-pinctrl-common.yaml
```yaml
# SPDX-License-Identifier: GPL-2.0
%YAML 1.2
---
$id: http://devicetree.org/schemas/pinctrl/hisilicon,histb-pinctrl-common.yaml#
$schema: http://devicetree.org/meta-schemas/core.yaml#

title: HiSilicon HiSTB SoCs Pinctrl Controller

maintainers:
  - Yang Xiwen <forbidden405@outlook.com>

description: |
  Pinctrl for HiSilicon HiSTB SoCs are commonly separated into two parts. Most
  pins are controlled via IOCONFIG register space, the rest are controlled
  within sysctrl core.

  Both support per-pin pinmux and pinconf settings. Though the register fields
  and offsets may differ.

allOf:
  - $ref: pinctrl.yaml#

addtionalProperties: true

$defs:
  histb-pin-state:
    properties:
      pins:
        items:
          pattern: "^[A-Z]+[0-9]+$"

      drive-strength:
        minimum: 1
        maximum: 16

      slew-rate:
        enum: [0, 1]

      bias-pull-down: true
      bias-pull-up: true
      bias-disable: true
      input-schmitt-enable: true

      function: true

    required:
      - pins
      - function

    allOf:
      - $ref: pincfg-node.yaml#
      - $ref: pinmux-node.yaml#

    unevaluatedProperties: false
...
```

## Documentation/devicetree/bindings/pwm/hisilicon,pmc-pwm.yaml
```yaml
# SPDX-License-Identifier: (GPL-2.0-only OR BSD-2-Clause)
%YAML 1.2
---
$id: http://devicetree.org/schemas/pwm/hisilicon,pmc-pwm.yaml#
$schema: http://devicetree.org/meta-schemas/core.yaml#

title: HiSilicon PMC PWM device

maintainers:
  - Yang Xiwen <forbidden405@outlook.com>

allOf:
  - $ref: pwm.yaml#

properties:
  compatible:
    items:
      - enum:
          - hisilicon,hi3798mv200-pwm
      - const: hisilicon,pmc-pwm

  reg:
    maxItems: 1

  clocks:
    maxItems: 1

  "#pwm-cells":
    const: 3

required:
  - compatible
  - reg
  - clocks

additionalProperties: false

examples:
  - |
    pwm@18 {
      compatible = "hisilicon,hi3798mv200-pwm", "hisilicon,pmc-pwm";
      reg = <0x18 0x4>;
      clocks = <&clk>;
      #pwm-cells = <3>;
    };
```

## drivers/pinctrl/hisilicon/Kconfig
```kconfig
# SPDX-License-Identifier: GPL-2.0-or-later
if (ARCH_HISI || COMPILE_TEST)

config PINCTRL_HISILICON
	bool

config PINCTRL_HISTB
	tristate "HiSilicon HiSTB SoCs pinctrl framework"
	select PINCTRL_HISILICON
	select GENERIC_PINCONF
	select GENERIC_PINCTRL_GROUPS
	select GENERIC_PINMUX_FUNCTIONS

	help
	  Support HiSTB SoCs pinctrl module

menu "HiSTB pinctrl drivers"
	depends on PINCTRL_HISTB

config PINCTRL_HI3798MV2X
	tristate "HiSilicon Hi3798MV2X pinctrl driver"
	depends on PINCTRL_HISTB
	help
	  Support IOCONFIG core on Hi3798MV2X SoCs

endmenu

endif
```
