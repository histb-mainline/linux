## Documentation/devicetree/bindings/clock/hisilicon,hisi-crg.yaml
```yaml
# SPDX-License-Identifier: (GPL-2.0-only OR BSD-2-Clause)
%YAML 1.2
---
$id: http://devicetree.org/schemas/clock/hisilicon,hisi-crg.yaml#
$schema: http://devicetree.org/meta-schemas/core.yaml#

title: HiSilicon SoC Clock and Reset Generator (CRG) module

maintainers:
  - David Yang <mmyangfl@gmail.com>

description: |
  The CRG module provides clock and reset signals to various modules within
  the SoC.

properties:
  compatible:
    oneOf:
      - const: hisilicon,hi3519-crg
      - items:
          - enum:
              - hisilicon,hi3516cv300-sysctrl
              - hisilicon,hi3798cv200-sysctrl
              - hisilicon,hi3798mv100-sysctrl
          - const: syscon
      - items:
          - enum:
              - hisilicon,hi3516cv300-crg
              - hisilicon,hi3798cv200-crg
              - hisilicon,hi3798mv100-crg
          - const: syscon
          - const: simple-mfd

  reg:
    maxItems: 1

  '#clock-cells':
    const: 1
    description:
      Each clock is assigned an identifier and client nodes use that
      identifier to specify the clock they consume. The identifiers of a
      given SoC are listed in the matching dt-bindings/clock header.

  '#reset-cells':
    const: 2
    description:
      A reset signal is controlled by a bit in a register of the CRG module.
      The first cell is the register offset relative to the base address, the
      second cell the bit index in that register.

  reset-controller:
    type: object
    description:
      The GMAC PHY reset of the Hi3798CV200 core CRG, described with the
      generic syscon reset binding.

required:
  - compatible
  - reg
  - '#clock-cells'
  - '#reset-cells'

unevaluatedProperties: false

allOf:
  - if:
      properties:
        compatible:
          contains:
            const: hisilicon,hi3798cv200-crg
    then:
      required:
        - reset-controller
    else:
      properties:
        reset-controller: false

examples:
  - |
    clock-reset-controller@12010000 {
        compatible = "hisilicon,hi3519-crg";
        reg = <0x12010000 0x10000>;
        #clock-cells = <1>;
        #reset-cells = <2>;
    };
```

## Documentation/devicetree/bindings/display/bridge/hisilicon,hi3798mv100-hdmi.yaml
```yaml
# SPDX-License-Identifier: (GPL-2.0-only OR BSD-2-Clause)
%YAML 1.2
---
$id: http://devicetree.org/schemas/display/bridge/hisilicon,hi3798mv100-hdmi.yaml#
$schema: http://devicetree.org/meta-schemas/core.yaml#

title: HiSilicon HiSTB HDMI transmitter (SiI9134 core)

maintainers:
  - David Yang <mmyangfl@gmail.com>

description: |
  The HDMI 1.4 transmitter of the HiSilicon Hi3798MV100 and Hi3716CV200, a
  Silicon Image SiI9134 core plus an on-chip PHY. The two I2C banks of the
  standalone part are flattened into one register window, bank 0 at the base,
  bank 1 at offset 0x400 and the 32-bit PHY registers at offset 0x1800, so a
  single 64 KiB reg entry covers all three.

  The clock gates of the block are two groups in the CRG, one for the controller
  (PERI_CRG67 bits 5:0) and one for the PHY (PERI_CRG68 bit 0), and both are
  exposed as clocks. A reset request only reaches the block while it is clocked,
  so the driver enables them before it pulses the reset lines below. Both SoCs
  keep the controller reset in PERI_CRG67 bits 9 and 8 and the PHY reset in
  PERI_CRG68 bit 4, which is what the reset cells below name.

  The transmitter's own reduced DDC master is registered as an I2C bus carrying
  this node's of_node, so the EDID is read over that bus and a connector node
  can point its ddc-i2c-bus at this device.

properties:
  compatible:
    enum:
      - hisilicon,hi3798mv100-hdmi
      - hisilicon,hi3716cv200-hdmi

  '#sound-dai-cells':
    const: 0

  reg:
    maxItems: 1

  interrupts:
    maxItems: 1

  clocks:
    items:
      - description: Gates of the transmitter controller, PERI_CRG67 bits 5:0.
      - description: Gate of the transmitter PHY, PERI_CRG68 bit 0.

  clock-names:
    items:
      - const: ctrl
      - const: phy

  resets:
    maxItems: 3

  reset-names:
    items:
      - const: base
      - const: bus
      - const: phy

  ports:
    $ref: /schemas/graph.yaml#/properties/ports

    properties:
      port@0:
        $ref: /schemas/graph.yaml#/properties/port
        description:
          Pixel input from the VDP channel.

    required:
      - port@0

required:
  - compatible
  - reg
  - clocks
  - clock-names
  - resets
  - reset-names
  - ports

additionalProperties: false

examples:
  - |
    #include <dt-bindings/clock/hisilicon,hi3798mv100-crg.h>

    hdmi@8ce0000 {
        compatible = "hisilicon,hi3798mv100-hdmi";
        reg = <0x8ce0000 0x10000>;
        interrupts = <88 4>;
        clocks = <&crg HI3798MV100_HDMI_CTRL_CLK>,
                 <&crg HI3798MV100_HDMI_PHY_CLK>;
        clock-names = "ctrl", "phy";
        resets = <&crg 0x10c 9>, <&crg 0x10c 8>, <&crg 0x110 4>;
        reset-names = "base", "bus", "phy";
        #sound-dai-cells = <0>;

        ports {
            #address-cells = <1>;
            #size-cells = <0>;

            port@0 {
                reg = <0>;

                hdmi_in_vdp: endpoint {
                    remote-endpoint = <&vdp_out_hdmi>;
                };
            };
        };
    };
  - |
    #include <dt-bindings/clock/hisilicon,hi3716cv200-crg.h>
    #include <dt-bindings/interrupt-controller/arm-gic.h>

    hdmi@f8ce0000 {
        compatible = "hisilicon,hi3716cv200-hdmi";
        reg = <0xf8ce0000 0x10000>;
        interrupts = <GIC_SPI 88 IRQ_TYPE_LEVEL_HIGH>;
        clocks = <&crg HI3716CV200_HDMITX_CTRL_CLK>,
                 <&crg HI3716CV200_HDMITX_PHY_CLK>;
        clock-names = "ctrl", "phy";
        resets = <&crg 0x10c 9>, <&crg 0x10c 8>, <&crg 0x110 4>;
        reset-names = "base", "bus", "phy";
        #sound-dai-cells = <0>;

        ports {
            #address-cells = <1>;
            #size-cells = <0>;

            port@0 {
                reg = <0>;

                cv200_hdmi_in_vdp: endpoint {
                    remote-endpoint = <&vdp_out_hdmi>;
                };
            };
        };
    };
```

## Documentation/devicetree/bindings/display/hisilicon/hisilicon,hi3798mv100-vdp.yaml
```yaml
# SPDX-License-Identifier: (GPL-2.0-only OR BSD-2-Clause)
%YAML 1.2
---
$id: http://devicetree.org/schemas/display/hisilicon/hisilicon,hi3798mv100-vdp.yaml#
$schema: http://devicetree.org/meta-schemas/core.yaml#

title: HiSilicon Hi3798MV100 VDP v2 display engine

maintainers:
  - David Yang <mmyangfl@gmail.com>

description: |
  The VDP block composites the graphics layers onto a display channel and drives
  the timing of that channel. This driver exposes DHD0, the HD channel wired to
  the on-chip HDMI transmitter, whose pixel clock the two blocks share.

  hi3716cv200 uses the same register file for its output channel; the one block
  whose layout differs is the GP0 zoom engine, where cv200 keeps both horizontal
  offsets in a single register and takes both ratios in 4.12 fixed point.

properties:
  compatible:
    enum:
      - hisilicon,hi3798mv100-vdp
      - hisilicon,hi3716cv200-vdp

  reg:
    maxItems: 1

  interrupts:
    maxItems: 1

  clocks:
    items:
      - description:
          HD channel clock. The transmitter is fed from the same clock, so the
          two blocks cannot disagree about the pixel clock.
      - description:
          The rest of the display channel's gates (CRG54 bits 6:0 apart from
          vo_hd_cken, which is the channel clock above). A reset request only
          reaches the block while it is clocked, so the driver enables these
          before it pulses the reset below.

  clock-names:
    items:
      - const: pix
      - const: vo

  resets:
    maxItems: 1
    description:
      VOU soft reset (CRG54 bit 30). The driver pulses it before it configures
      the block, so the display controller comes up from its reset defaults
      instead of whatever an earlier stage left behind.

  memory-region:
    maxItems: 1
    description:
      Phandle to a node describing memory to be used for the framebuffer. If not
      present, the framebuffer may be located anywhere in memory. The channel
      takes a single base address and has no MMU, so frame buffers also have to
      be physically contiguous.

  ports:
    $ref: /schemas/graph.yaml#/properties/ports

    properties:
      port@0:
        $ref: /schemas/graph.yaml#/properties/port
        description:
          Pixel output of the channel, connected to the input of the HDMI
          transmitter.

    required:
      - port@0

required:
  - compatible
  - reg
  - clocks
  - clock-names
  - resets
  - ports

additionalProperties: false

examples:
  - |
    #include <dt-bindings/clock/hisilicon,hi3798mv100-crg.h>

    display@8cc0000 {
        compatible = "hisilicon,hi3798mv100-vdp";
        reg = <0x8cc0000 0x10000>;
        interrupts = <90 4>;
        clocks = <&crg HI3798MV100_VO_HD_CLK>, <&crg HI3798MV100_VO_CLK>;
        clock-names = "pix", "vo";
        resets = <&crg 0xd8 30>;

        ports {
            #address-cells = <1>;
            #size-cells = <0>;

            port@0 {
                reg = <0>;

                vdp_out_hdmi: endpoint {
                    remote-endpoint = <&hdmi_in_vdp>;
                };
            };
        };
    };
```

## Documentation/devicetree/bindings/display/hisilicon/hisilicon,hi3798mv200-hdmi.yaml
```yaml
# SPDX-License-Identifier: (GPL-2.0-only OR BSD-2-Clause)
%YAML 1.2
---
$id: http://devicetree.org/schemas/display/hisilicon/hisilicon,hi3798mv200-hdmi.yaml#
$schema: http://devicetree.org/meta-schemas/core.yaml#

title: HiSilicon Hi3798MV200 HDMI transmitter

maintainers:
  - David Yang <mmyangfl@gmail.com>

description: |
  The on-chip HDMI transmitter takes the pixel stream of one VDP display
  channel and serialises it onto a TMDS link. It is made of two register
  windows, the digital blocks (encoder, video path, packetiser, DDC master)
  and the analog PHY, and it needs two divider fields and the resets of the
  SoC clock generator, which is why it also refers to that block.

properties:
  compatible:
    const: hisilicon,hi3798mv200-hdmi

  reg:
    minItems: 2
    maxItems: 2

  reg-names:
    items:
      - const: tx
      - const: phy

  clocks:
    items:
      - description:
          HD channel pixel clock. The channel and this transmitter run off the
          same clock, so neither can disagree about the pixel clock.
      - description: Gate of the TMDS clock the PHY is driven from.

  clock-names:
    items:
      - const: pix
      - const: tmds

  resets:
    maxItems: 4
    description:
      The resets of the transmitter's blocks in the clock generator, being the
      controller bus, the controller, the spread spectrum block and the TMDS
      clock path. The PHY's own request bit is not listed here, because the
      driver pulses it as part of a divider change.

  "#sound-dai-cells":
    const: 0

  hisilicon,crg:
    $ref: /schemas/types.yaml#/definitions/phandle
    description:
      Phandle of the clock generator, which the driver reaches as a syscon
      because the two divider fields it owns there are picked from the mode and
      cannot be expressed as a clock rate.

  ports:
    $ref: /schemas/graph.yaml#/properties/ports

    properties:
      port@0:
        $ref: /schemas/graph.yaml#/properties/port
        description:
          Pixel input of the transmitter, connected to the output of the VDP
          display channel it feeds.

    required:
      - port@0

required:
  - compatible
  - reg
  - reg-names
  - clocks
  - clock-names
  - resets
  - hisilicon,crg
  - ports

additionalProperties: false

examples:
  - |
    #include <dt-bindings/clock/hisilicon,hi3798mv200-crg.h>

    hdmi: hdmi@8ce0000 {
        compatible = "hisilicon,hi3798mv200-hdmi";
        reg = <0x8ce0000 0x20000>, <0x8d30000 0x1000>;
        reg-names = "tx", "phy";
        clocks = <&crg HI3798MV200_VO_HD>, <&crg HI3798MV200_HDMITX_PHY_TMDS_CLK>;
        clock-names = "pix", "tmds";
        resets = <&crg 0x10c 6>, <&crg 0x10c 7>, <&crg 0x10c 9>,
                 <&crg 0x110 5>;
        hisilicon,crg = <&crg>;

        ports {
            #address-cells = <1>;
            #size-cells = <0>;

            port@0 {
                reg = <0>;

                hdmi_in_vdp: endpoint {
                    remote-endpoint = <&vdp_out_hdmi>;
                };
            };
        };
    };
```
