## Documentation/devicetree/bindings/media/hisilicon,hix5hd2-ir.yaml
```yaml
# SPDX-License-Identifier: (GPL-2.0-only OR BSD-2-Clause)
%YAML 1.2
---
$id: http://devicetree.org/schemas/media/hisilicon,hix5hd2-ir.yaml#
$schema: http://devicetree.org/meta-schemas/core.yaml#

title: HiSilicon Hix5hd2 Infrared Receiver

maintainers:
  - David Yang <mmyangfl@gmail.com>

description: |
  The receiver turns the demodulated carrier back into symbols and hands them
  to the CPU, which runs the protocol decoder over them.

  Bringing the block up takes its clock plus, on some SoCs, one more bit in a
  system controller register; hisilicon,power-syscon points at that register
  file and the driver sets the bit there.  Hi3798CV200 and Hi3798MV200 keep
  that bit inside the same window as the clock gate the clock provider already
  covers, so they need no phandle.

allOf:
  - $ref: rc.yaml#

properties:
  compatible:
    enum:
      - hisilicon,hix5hd2-ir
      - hisilicon,hi3796cv300-ir

  reg:
    maxItems: 1

  interrupts:
    maxItems: 1

  clocks:
    maxItems: 1

  hisilicon,power-syscon:
    $ref: /schemas/types.yaml#/definitions/phandle
    description:
      System controller that holds the extra bit enabling the receiver.

required:
  - compatible
  - reg
  - interrupts
  - clocks

unevaluatedProperties: false

examples:
  - |
    ir@1000 {
        compatible = "hisilicon,hix5hd2-ir";
        reg = <0x1000 0x1000>;
        interrupts = <0 47 4>;
        clocks = <&clock 35>;
        hisilicon,power-syscon = <&sysctrl>;
        linux,rc-map-name = "rc-rc6-mce";
    };
```

## Documentation/devicetree/bindings/mtd/hisilicon,hi3716cv200-nand-controller.yaml
```yaml
# SPDX-License-Identifier: (GPL-2.0-only OR BSD-2-Clause)
%YAML 1.2
---
$id: http://devicetree.org/schemas/mtd/hisilicon,hi3716cv200-nand-controller.yaml#
$schema: http://devicetree.org/meta-schemas/core.yaml#

title: HiSilicon Hi3716CV200 NAND Flash Controller (hinfc610)

maintainers:
  - David Yang <mmyangfl@gmail.com>

description: |
  The NAND flash controller of the Hi3716CV200 separates its register file
  from the window the command, address and status bytes travel through, so
  both ranges are listed. Transfers are set up in the register file and moved
  by the block's own DMA engine; the completion is polled, because the
  interrupts of this instance are not wired to the distributor.

  The engine corrects eight bits per 1024-byte step, and the only page size
  this generation has been used with is 2 KiB.

  The reset is the block's own soft reset, CRG24 bit 4, which sits beside the
  clock gate in the same register; the driver holds it and releases it before
  it writes any of its registers, so the block is never configured with the
  state a previous owner left in it.

allOf:
  - $ref: nand-controller.yaml

properties:
  compatible:
    const: hisilicon,hi3716cv200-nand-controller

  reg:
    minItems: 2
    maxItems: 2

  clocks:
    maxItems: 1

  resets:
    maxItems: 1

  nand-ecc-strength:
    const: 8

  nand-ecc-step-size:
    enum: [ 512, 1024 ]

required:
  - compatible
  - reg
  - clocks
  - resets

unevaluatedProperties: false

examples:
  - |
    #include <dt-bindings/clock/hisilicon,hi3716cv200-crg.h>

    nandc: nand-controller@f9810000 {
        compatible = "hisilicon,hi3716cv200-nand-controller";
        reg = <0xf9810000 0x100>, <0xfe000000 0x2176>;
        clocks = <&crg HI3716CV200_NAND_CLK>;
        resets = <&crg 0x60 4>;
        #address-cells = <1>;
        #size-cells = <0>;

        nand-ecc-strength = <8>;
        nand-ecc-step-size = <1024>;
    };
```

## Documentation/devicetree/bindings/net/hisilicon,hisi-femac.yaml
```yaml
# SPDX-License-Identifier: GPL-2.0-only OR BSD-2-Clause
%YAML 1.2
---
$id: http://devicetree.org/schemas/net/hisilicon,hisi-femac.yaml#
$schema: http://devicetree.org/meta-schemas/core.yaml#

title: Hisilicon Fast Ethernet MAC controller

maintainers:
  - Yang Xiwen <forbidden405@foxmail.com>

allOf:
  - $ref: ethernet-controller.yaml#
  - if:
      properties:
        compatible:
          contains:
            const: hisilicon,hisi-femac
    then:
      required:
        - clock-names
        - phy-connection-type
        - phy-handle
      properties:
        clocks:
          minItems: 3

description: |
  The FEMAC core has one register window for the MAC itself and a second one
  for the global MAC control. hi3798mv200 wires three clocks to it and names
  them, and its MDIO bus is a child node the MAC driver populates. Earlier
  members of the family (hisi-femac-v1/-v2, hi3516cv300) name no clocks at all
  and keep the MDIO bus in a sibling node, which the bus driver binds to
  directly; their clock cell stays unnamed there because the block has a single
  clock.

properties:
  compatible:
    oneOf:
      - items:
          - enum:
              - hisilicon,hi3798mv200-femac
          - const: hisilicon,hisi-femac
      - enum:
          - hisilicon,hisi-femac-v1
          - hisilicon,hisi-femac-v2
          - hisilicon,hi3516cv300-femac

  reg:
    items:
      - description: The first region is the MAC core register base and size.
      - description: The second region is the global MAC control register.

  ranges:
    maxItems: 1

  '#address-cells':
    const: 1

  '#size-cells':
    const: 1

  interrupts:
    maxItems: 1

  clocks:
    minItems: 1
    maxItems: 3

  clock-names:
    minItems: 1
    items:
      - const: mac
      - const: macif
      - const: phy

  resets:
    maxItems: 2

  reset-names:
    items:
      - const: mac
      - const: phy

  hisilicon,phy-reset-delays-us:
    items:
      - description: The 1st cell is reset pre-delay in micro seconds.
      - description: The 2nd cell is reset pulse in micro seconds.
      - description: The 3rd cell is reset post-delay in micro seconds.

patternProperties:
  '^mdio@[0-9a-f]+$':
    $ref: hisilicon,hisi-femac-mdio.yaml#

required:
  - compatible
  - reg
  - interrupts
  - clocks
  - resets
  - hisilicon,phy-reset-delays-us

unevaluatedProperties: false

examples:
  - |
    #include <dt-bindings/interrupt-controller/arm-gic.h>

    ethernet@9c30000 {
        compatible = "hisilicon,hi3798mv200-femac", "hisilicon,hisi-femac";
        reg = <0x9c30000 0x1000>, <0x9c31300 0x200>;
        ranges = <0x0 0x9c30000 0x10000>;
        #address-cells = <1>;
        #size-cells = <1>;
        interrupts = <GIC_SPI 72 IRQ_TYPE_LEVEL_HIGH>;
        clocks = <&clk_femac>,
                 <&clk_femacif>,
                 <&clk_fephy>;
        clock-names = "mac", "macif", "phy";
        resets = <&crg 0xd0 3>, <&crg 0x388 4>;
        reset-names = "mac", "phy";
        phy-handle = <&fephy>;
        phy-connection-type = "mii";
        // To be filled by bootloader
        mac-address = [00 00 00 00 00 00];
        hisilicon,phy-reset-delays-us = <10000 10000 500000>;
        status = "okay";

        mdio@1100 {
            compatible = "hisilicon,hisi-femac-mdio";
            reg = <0x1100 0x20>;
            #address-cells = <1>;
            #size-cells = <0>;
            status = "okay";

            ethernet-phy@1 {
                reg = <1>;
            };
        };
    };

  - |
    #include <dt-bindings/interrupt-controller/arm-gic.h>

    ethernet@9840000 {
        compatible = "hisilicon,hisi-femac-v2";
        reg = <0x9840000 0x1000>, <0x9841300 0x200>;
        interrupts = <GIC_SPI 71 IRQ_TYPE_LEVEL_HIGH>;
        clocks = <&crg 12>;
        resets = <&crg 0xcc 4>, <&crg 0x120 4>;
        reset-names = "mac", "phy";
        phy-handle = <&phy1>;
        phy-mode = "mii";
        hisilicon,phy-reset-delays-us = <10000 10000 20000>;
    };
```

## Documentation/devicetree/bindings/phy/hisilicon,hi3716cv200-sata-phy.yaml
```yaml
# SPDX-License-Identifier: (GPL-2.0-only OR BSD-2-Clause)
%YAML 1.2
---
$id: http://devicetree.org/schemas/phy/hisilicon,hi3716cv200-sata-phy.yaml#
$schema: http://devicetree.org/meta-schemas/core.yaml#

title: HiSilicon Hi3716CV200 SATA PHY

maintainers:
  - David Yang <mmyangfl@gmail.com>

description: |
  The SATA PHY of the Hi3716CV200 sits in the controller's own register
  window, so this node covers the same bytes the ahci host maps. The host
  cannot be brought out of its power-on default until the two reset bits of
  the SATA CRG word have seen an edge, which is why the resets belong here
  rather than on the host, and the disk supply is switched through the
  PERI system controller.

properties:
  compatible:
    const: hisilicon,hi3716cv200-sata-phy

  reg:
    maxItems: 1

  resets:
    minItems: 2
    maxItems: 2
    description:
      The bus and cko-alive reset request bits of the SATA CRG word. Both
      are pulsed when the PHY is powered on.

  '#phy-cells':
    const: 0

  hisilicon,peri-syscon:
    $ref: /schemas/types.yaml#/definitions/phandle
    description:
      Phandle of the PERI system controller, whose word named by
      hisilicon,power-reg carries the SATA disk supply bit.

  hisilicon,power-reg:
    description: Offset and bit number within the PERI system controller
      register controlling the SATA disk supply.
    $ref: /schemas/types.yaml#/definitions/uint32-array
    items:
      - description: Offset within the PERI system controller register.
      - description: Bit number controlling the SATA disk supply.

required:
  - compatible
  - reg
  - resets
  - '#phy-cells'
  - hisilicon,peri-syscon
  - hisilicon,power-reg

additionalProperties: false

examples:
  - |
    soc {
        #address-cells = <1>;
        #size-cells = <1>;
        ranges;

        crg: clock-reset-controller@f8a22000 {
            compatible = "hisilicon,hi3716cv200-crg", "syscon", "simple-mfd";
            reg = <0xf8a22000 0x400>;
            #clock-cells = <1>;
            #reset-cells = <2>;
        };

        peri_syscon: system-control@f8a20000 {
            compatible = "hisilicon,hi3716cv200-peri-syscon", "syscon";
            reg = <0xf8a20000 0x1000>;
        };

        sata_phy: sata-phy@f9900000 {
            compatible = "hisilicon,hi3716cv200-sata-phy";
            reg = <0xf9900000 0x1000>;
            resets = <&crg 0xa8 8>, <&crg 0xa8 9>;
            #phy-cells = <0>;
            hisilicon,peri-syscon = <&peri_syscon>;
            hisilicon,power-reg = <0x8 10>;
        };
    };
```

## Documentation/devicetree/bindings/regulator/hisilicon,hi3798cv200-regulator.yaml
```yaml
# SPDX-License-Identifier: (GPL-2.0-only OR BSD-2-Clause)
%YAML 1.2
---
$id: http://devicetree.org/schemas/regulator/hisilicon,hi3798cv200-regulator.yaml#
$schema: http://devicetree.org/meta-schemas/core.yaml#

title: HiSilicon STB voltage regulator

maintainers:
  - David Yang <mmyangfl@gmail.com>

description: |
  HiSilicon STB SoCs (Hi3798cv200/mv100/mv200) provide PWM outputs in the PMOC
  block which drive an external converter.

  The voltage range depends on the board design: reference designs specify 0.65
  V to 1.15 V for the Hi3798cv200, and 0.7 V to 1.25 V for the Hi3798mv200; a
  customized board has to figure out its own. The regulator itself has no other
  source of calibration.

properties:
  compatible:
    const: hisilicon,hi3798cv200-regulator

  reg:
    maxItems: 1

required:
  - compatible
  - reg
  - regulator-min-microvolt
  - regulator-max-microvolt

allOf:
  - $ref: regulator.yaml#

unevaluatedProperties: false

examples:
  - |
    vddcpu: regulator@8a23018 {
        compatible = "hisilicon,hi3798cv200-regulator";
        reg = <0x8a23018 0x4>;
        regulator-name = "vdd-cpu";
        regulator-min-microvolt = <650000>;
        regulator-max-microvolt = <1150000>;
        regulator-always-on;
    };
```

## Documentation/devicetree/bindings/rng/hisilicon,histb-rng.yaml
```yaml
# SPDX-License-Identifier: (GPL-2.0-only OR BSD-2-Clause)
%YAML 1.2
---
$id: http://devicetree.org/schemas/rng/hisilicon,histb-rng.yaml#
$schema: http://devicetree.org/meta-schemas/core.yaml#

title: HiSilicon STB true random number generator

maintainers:
  - David Yang <mmyangfl@gmail.com>

description: |
  The TRNG block of HiSilicon STB SoCs. It exposes three registers -- a control
  word that starts the post processor and sets its depth, a data word, and a
  status word whose low bits count how many words are ready. The block has no
  gate of its own in the CRG: on hi3798mv100 it shares the SHA engine's clock
  gate and soft reset (PERI CRG register +0xc4, bits 0 and 4), which the boot
  loader leaves enabled, so reading the block needs no clocks or resets
  property.

properties:
  compatible:
    const: hisilicon,histb-rng

  reg:
    maxItems: 1
    description:
      The three registers, so the entry starts at the control word. On
      hi3798mv100 the control word sits at the base of the enclosing 4 KiB TRNG
      window at 0xf8005000.

required:
  - compatible
  - reg

additionalProperties: false

examples:
  - |
    rng@8005000 {
        compatible = "hisilicon,histb-rng";
        reg = <0x8005000 0x1000>;
    };
```

## Documentation/devicetree/bindings/sound/hisilicon,hi3716cv200-adac.yaml
```yaml
# SPDX-License-Identifier: (GPL-2.0-only OR BSD-2-Clause)
%YAML 1.2
---
$id: http://devicetree.org/schemas/sound/hisilicon,hi3716cv200-adac.yaml#
$schema: http://devicetree.org/meta-schemas/core.yaml#

title: HiSilicon Hi3716CV200 internal audio DAC

maintainers:
  - David Yang <mmyangfl@gmail.com>

description: |
  The analog output stage of the Hi3716CV200, reached through two 32-bit
  registers next to the CRG. It is a consumer of the AIAO transmit port's
  serial stream rather than a source of its own, so it carries no DMA or
  interrupt of its own and is wired to that port by the sound card node.

  The driver's only state is the power and mute bit the vendor's own audio HAL
  toggles at stream start and stop, which is why it claims the gate clock and
  the reset line: a write to the block does not land while either is off.

properties:
  compatible:
    const: hisilicon,hi3716cv200-adac

  reg:
    maxItems: 1

  clocks:
    maxItems: 1
    description: Gate of the DAC (PERI_CRG69 bit 0).

  resets:
    maxItems: 1
    description:
      DAC soft reset (PERI_CRG69 bit 4). The cell pair is a register offset
      and a bit number, which is what reset-cells = <2> asks of the CRG.

  '#sound-dai-cells':
    const: 0

required:
  - compatible
  - reg
  - clocks
  - resets
  - '#sound-dai-cells'

additionalProperties: false

examples:
  - |
    #include <dt-bindings/clock/hisilicon,hi3716cv200-crg.h>

    audio-codec@f8a20110 {
        compatible = "hisilicon,hi3716cv200-adac";
        reg = <0xf8a20110 0x8>;
        clocks = <&crg HI3716CV200_ADAC_CLK>;
        resets = <&crg 0x114 4>;
        #sound-dai-cells = <0>;
    };
```
