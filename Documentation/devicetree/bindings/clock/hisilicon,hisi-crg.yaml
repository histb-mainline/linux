## Documentation/devicetree/bindings/display/hisilicon/hisilicon,hi3798mv200-vdp.yaml
```yaml
# SPDX-License-Identifier: (GPL-2.0-only OR BSD-2-Clause)
%YAML 1.2
---
$id: http://devicetree.org/schemas/display/hisilicon/hisilicon,hi3798mv200-vdp.yaml#
$schema: http://devicetree.org/meta-schemas/core.yaml#

title: HiSilicon Hi3798MV200 VDP display engine

maintainers:
  - David Yang <mmyangfl@gmail.com>

description: |
  The VDP block composites the graphics layers onto a display channel and drives
  the timing of that channel. This driver exposes DHD0, the HD channel wired to
  the on-chip HDMI transmitter, whose pixel clock the two blocks share.

properties:
  compatible:
    const: hisilicon,hi3798mv200-vdp

  reg:
    maxItems: 1

  interrupts:
    maxItems: 1

  clocks:
    items:
      - description:
          HD channel clock. The transmitter is fed from the same clock, so the
          two blocks cannot disagree about the pixel clock.
      - description:
          Gate of the display channel's bus (CRG54 bit 0).
      - description:
          Gate of the channel's timing encoder (CRG54 bit 3). A reset request
          only reaches the block while it is clocked, so the driver enables
          these before it pulses the reset below.

  clock-names:
    items:
      - const: pix
      - const: bus
      - const: sdate

  resets:
    maxItems: 1
    description:
      The block's own soft reset (CRG211 bit 29), named vdp. It has to be
      released before any clock feeding the register file is raised, because an
      access with the HD domain clocked while that request is still held locks
      the bus instead of returning a value.

  reset-names:
    items:
      - const: vdp

  hisilicon,crg:
    $ref: /schemas/types.yaml#/definitions/phandle
    description:
      Phandle of the clock generator. The driver reaches one more field there
      by hand, the VOU reset request in CRG54 bit 30, whose register file is
      only reachable with that bit raised, and which the reset framework cannot
      describe because the bit means the opposite of what its assert does.

  memory-region:
    maxItems: 1
    description:
      Phandle to a node describing memory to be used for the framebuffer. If not
      present, the framebuffer may be located anywhere in memory. The channel
      takes a single base address and has no MMU, so frame buffers also have to
      be physically contiguous.

  ports:
    $ref: /schemas/graph.yaml#/properties/ports

    properties:
      port@0:
        $ref: /schemas/graph.yaml#/properties/port
        description:
          Pixel output of the channel, connected to the input of the HDMI
          transmitter.

    required:
      - port@0

required:
  - compatible
  - reg
  - clocks
  - clock-names
  - resets
  - hisilicon,crg
  - ports

additionalProperties: false

examples:
  - |
    #include <dt-bindings/clock/hisilicon,hi3798mv200-crg.h>
    #include <dt-bindings/interrupt-controller/arm-gic.h>

    display@f8cc0000 {
        compatible = "hisilicon,hi3798mv200-vdp";
        reg = <0xf8cc0000 0x10000>;
        interrupts = <GIC_SPI 90 IRQ_TYPE_LEVEL_HIGH>;
        clocks = <&crg HI3798MV200_VO_HD>, <&crg HI3798MV200_VO_BUS>,
                 <&crg HI3798MV200_VO_SDATE>;
        clock-names = "pix", "bus", "sdate";
        resets = <&crg 0x34c 29>;
        reset-names = "vdp";
        hisilicon,crg = <&crg>;

        ports {
            #address-cells = <1>;
            #size-cells = <0>;

            port@0 {
                reg = <0>;

                vdp_out_hdmi: endpoint {
                    remote-endpoint = <&hdmi_in_vdp>;
                };
            };
        };
    };
```

## Documentation/devicetree/bindings/dma/hisilicon,hi3798mv100-dmac.yaml
```yaml
# SPDX-License-Identifier: (GPL-2.0-only OR BSD-2-Clause)
%YAML 1.2
---
$id: http://devicetree.org/schemas/dma/hisilicon,hi3798mv100-dmac.yaml#
$schema: http://devicetree.org/meta-schemas/core.yaml#

title: HiSilicon STB SoCs DMA Controller

maintainers:
  - David Yang <mmyangfl@gmail.com>

allOf:
  - $ref: dma-controller.yaml#

properties:
  compatible:
    const: hisilicon,hi3798mv100-dmac

  reg:
    maxItems: 1

  interrupts:
    maxItems: 1

  clocks:
    maxItems: 1

  resets:
    maxItems: 1

  dma-channels:
    const: 4

  "#dma-cells":
    const: 1
    description:
      The cell is the peripheral request line used for hardware
      handshaking.

required:
  - compatible
  - reg
  - interrupts
  - clocks
  - "#dma-cells"

unevaluatedProperties: false

examples:
  - |
    #include <dt-bindings/interrupt-controller/arm-gic.h>
    #include <dt-bindings/interrupt-controller/irq.h>
    #include <dt-bindings/clock/hisilicon,hi3798mv100-crg.h>

    dma-controller@9870000 {
        compatible = "hisilicon,hi3798mv100-dmac";
        reg = <0x9870000 0x10000>;
        interrupts = <GIC_SPI 30 IRQ_TYPE_LEVEL_HIGH>;
        clocks = <&crg HI3798MV100_DMAC_CLK>;
        resets = <&crg 0xa4 4>;
        dma-channels = <4>;
        #dma-cells = <1>;
    };
```

## Documentation/devicetree/bindings/media/hisilicon,hi3798mv100-jpgd.yaml
```yaml
# SPDX-License-Identifier: (GPL-2.0-only OR BSD-2-Clause)
%YAML 1.2
---
$id: http://devicetree.org/schemas/media/hisilicon,hi3798mv100-jpgd.yaml#
$schema: http://devicetree.org/meta-schemas/core.yaml#

title: HiSilicon Hi3798MV100 JPEG decoder (JPGD)

maintainers:
  - David Yang <mmyangfl@gmail.com>

description: |-
  The JPEG decoder of the Hi3798MV100 family. It is a block of its own next to
  the VDH video decoder, with its own register window, interrupt line and clock
  gate, and it is programmed with one picture at a time rather than as a
  stateless video decoder.

  Hi3716CV200 has the same block with the same register names at the same
  offsets, except that its register file has no entry at 0x134, where the
  Hi3798MV100 map places the MMU bypass word, so that one write is not made on
  that part.

properties:
  compatible:
    enum:
      - hisilicon,hi3798mv100-jpgd
      - hisilicon,hi3716cv200-jpgd

  reg:
    maxItems: 1
    description: |-
      Register window. The vendor driver maps 0x6f0 bytes, which covers the
      quantization and Huffman table files at 0x200 and above; Hi3716CV200's own
      header gives its length as 0x6bf (msp/drv/jpeg/include/hi_jpeg_reg.h).

  interrupts:
    maxItems: 1

  clocks:
    maxItems: 1

  clock-names:
    const: jpgd

  resets:
    maxItems: 1
    description: The block's own reset request in the clock and reset generator.

  reset-names:
    const: jpgd

  memory-region:
    maxItems: 1
    description: |-
      Phandle to a reserved memory region to allocate buffers from. The block
      is programmed with single physical addresses and has no MMU of its own
      here, so buffers have to be physically contiguous. Without this property
      they are taken from the default CMA area.

required:
  - compatible
  - reg
  - interrupts

additionalProperties: false

examples:
  - |
    #include <dt-bindings/interrupt-controller/arm-gic.h>
    #include <dt-bindings/clock/hisilicon,hi3798mv100-crg.h>

    jpeg-decoder@8c40000 {
        compatible = "hisilicon,hi3798mv100-jpgd";
        reg = <0x8c40000 0x6f0>;
        interrupts = <GIC_SPI 97 IRQ_TYPE_LEVEL_HIGH>;
        clocks = <&crg HI3798MV100_JPGD_CLK>;
        clock-names = "jpgd";
        resets = <&crg 0x7c 4>;
        reset-names = "jpgd";
    };
```

## Documentation/devicetree/bindings/media/hisilicon,hi3798mv100-jpge.yaml
```yaml
# SPDX-License-Identifier: (GPL-2.0-only OR BSD-2-Clause)
%YAML 1.2
---
$id: http://devicetree.org/schemas/media/hisilicon,hi3798mv100-jpge.yaml#
$schema: http://devicetree.org/meta-schemas/core.yaml#

title: HiSilicon Hi3798MV100 JPEG encoder (JPGE)

maintainers:
  - David Yang <mmyangfl@gmail.com>

description: |-
  The JPEG encoder of the Hi3798MV100 family. Like its decoder it is a block of
  its own, with its own register window, interrupt line and clock gate, and it
  codes one raw picture per job rather than working as a stateless video
  encoder. It has no frame-description or Huffman-table registers: its coder is
  built around the ITU-T T.81 Annex K tables, so only the quantisation file is
  programmed.

  Hi3716CV200 has the same block: its S_JPGE_REGS_TYPE accumulates to the same
  0x10c0 window with every name this driver touches at the same offset
  (msp/drv/jpge/src/jpge_reg.h).

properties:
  compatible:
    enum:
      - hisilicon,hi3798mv100-jpge
      - hisilicon,hi3716cv200-jpge

  reg:
    maxItems: 1
    description: |-
      Register window. The vendor driver maps 0x10c0 bytes, which reaches the
      end of the quantisation file at 0x1000.

  interrupts:
    maxItems: 1

  clocks:
    maxItems: 1

  clock-names:
    const: jpge

  resets:
    maxItems: 1
    description: The block's own reset request in the clock and reset generator.

  reset-names:
    const: jpge

  memory-region:
    maxItems: 1
    description: |-
      Phandle to a reserved memory region to allocate buffers from. The block
      is programmed with single physical addresses and has no MMU of its own
      here, so buffers have to be physically contiguous. Without this property
      they are taken from the default CMA area.

required:
  - compatible
  - reg
  - interrupts

additionalProperties: false

examples:
  - |
    #include <dt-bindings/interrupt-controller/arm-gic.h>
    #include <dt-bindings/clock/hisilicon,hi3798mv100-crg.h>

    jpeg-encoder@8c90000 {
        compatible = "hisilicon,hi3798mv100-jpge";
        reg = <0x8c90000 0x10c0>;
        interrupts = <GIC_SPI 102 IRQ_TYPE_LEVEL_HIGH>;
        clocks = <&crg HI3798MV100_JPGE_CLK>;
        clock-names = "jpge";
        resets = <&crg 0x90 4>;
        reset-names = "jpge";
    };
```

## Documentation/devicetree/bindings/media/hisilicon,hi3798mv100-vdec.yaml
```yaml
# SPDX-License-Identifier: (GPL-2.0-only OR BSD-2-Clause)
%YAML 1.2
---
$id: http://devicetree.org/schemas/media/hisilicon,hi3798mv100-vdec.yaml#
$schema: http://devicetree.org/meta-schemas/core.yaml#

title: HiSilicon HiSTB video decoder (VDH)

maintainers:
  - David Yang <mmyangfl@gmail.com>

description: |-
  The video decoder of the Hi3798MV100 family: a VDM register window plus the
  SCD block that holds the three decoder-global registers, with one interrupt
  line for the doorbell and one clock gate that also drops the subsystem reset.

  Hi3716CV200 has the same block, at the same addresses and with the same
  register offsets -- the vendor firmware for both parts reads its VDM base as
  0xf8c30000, its SCD base as 0xf8c3c000 and its doorbell as SPI 95 from a
  sysconfig.h that is byte-identical between the two products. That part runs
  the older generation of the core (HiVDHV200R004 against HiVDHV300R001), whose
  only difference that reaches this binding is that it has no HEVC path.

properties:
  compatible:
    enum:
      - hisilicon,hi3798mv100-vdec
      - hisilicon,hi3716cv200-vdec

  reg:
    items:
      - description:
          VDM register window. The size has to reach past 0x1014 so that the
          syntax-error statistics at the end of the block are readable.
      - description: SCD block with the three decoder global registers

  reg-names:
    items:
      - const: vdm
      - const: scd

  interrupts:
    maxItems: 1

  clocks:
    maxItems: 1

  clock-names:
    const: vdec

  resets:
    minItems: 2
    maxItems: 2
    description:
      Two reset requests in the clock and reset generator, both of which the
      vendor firmware releases before the register window answers reads - the
      subsystem-wide one and the VDM's own one.

  reset-names:
    items:
      - const: global
      - const: vdm

  memory-region:
    maxItems: 1
    description:
      Phandle to a reserved memory region to allocate decoder buffers from. Both
      queues are dma-contig and the message pool is programmed as a single
      physical base address, so these buffers have to be physically contiguous.
      Without this property they are taken from the default CMA area.

required:
  - compatible
  - reg
  - reg-names
  - interrupts
  - clocks
  - clock-names
  - resets
  - reset-names

unevaluatedProperties: false

examples:
  - |
    #include <dt-bindings/interrupt-controller/arm-gic.h>
    #include <dt-bindings/interrupt-controller/irq.h>
    #include <dt-bindings/clock/hisilicon,hi3798mv100-crg.h>

    video-codec@8c30000 {
        compatible = "hisilicon,hi3798mv100-vdec";
        reg = <0x8c30000 0x1100>, <0x8c3c000 0x1000>;
        reg-names = "vdm", "scd";
        interrupts = <GIC_SPI 95 IRQ_TYPE_LEVEL_HIGH>;
        clocks = <&crg HI3798MV100_VDH_CLK>;
        clock-names = "vdec";
        resets = <&crg 0x78 4>, <&crg 0x78 6>;
        reset-names = "global", "vdm";
    };
```

## Documentation/devicetree/bindings/media/hisilicon,hi3798mv100-venc.yaml
```yaml
# SPDX-License-Identifier: (GPL-2.0-only OR BSD-2-Clause)
%YAML 1.2
---
$id: http://devicetree.org/schemas/media/hisilicon,hi3798mv100-venc.yaml#
$schema: http://devicetree.org/meta-schemas/core.yaml#

title: HiSilicon HiSTB video encoder (VEDU)

maintainers:
  - David Yang <mmyangfl@gmail.com>

description: |-
  The H.264 encoder of the Hi3798MV100 family, which this generation of the
  vendor driver calls VEDU v1.0. It is a block of its own, with its own register
  window, interrupt line and clock gate, and unlike the stateless decoders of
  the family it is a coding engine: it takes raw pictures and produces network
  abstraction layer data, so it keeps reconstruction buffers of its own and a
  ring buffer for the coded stream.

  This block is a different generation from the one on Hi3798CV200, and the two
  register files are not interchangeable.

  Hi3716CV200 carries the same block: the vendor build for that part names its
  register file r008 while the Hi3798MV100 build names s5v100
  (msp/drv/venc/Makefile:26-29,73-74 with hal_venc.h:11-16), and the two decoded
  views agree on every offset -- 193 named registers, no offset differing, both
  files 65300 bytes long -- with the Hi3798MV100 view additionally decoding a
  colour-space-conversion coefficient block (seven registers and one mode bit)
  that the other part leaves reserved. The silicon is present on Hi3716CV200: at
  the revision word 0xf8c800fc it answers 0x56325238, the string "V2R8", on a
  board whose window the vendor clock gate keeps reachable. No board config in
  the vendor SDK enables it, so this is the first driver to program it there.

properties:
  compatible:
    enum:
      - hisilicon,hi3798mv100-venc
      - hisilicon,hi3716cv200-venc

  reg:
    maxItems: 1
    description: |-
      Register window. The vendor driver maps the whole 64 KiB it needs, which
      covers the quantisation scale list at 0x5e00.

  interrupts:
    maxItems: 1

  clocks:
    maxItems: 1

  clock-names:
    const: venc

  resets:
    maxItems: 1
    description: The block's own reset request in the clock and reset generator.

  reset-names:
    const: venc

  memory-region:
    maxItems: 1
    description: |-
      Phandle to a reserved memory region to allocate buffers from. The block is
      programmed with single physical addresses and has no MMU here, so its
      picture, reconstruction and stream buffers have to be physically
      contiguous. Without this property they are taken from the default CMA area.

required:
  - compatible
  - reg
  - interrupts

additionalProperties: false

examples:
  - |
    #include <dt-bindings/interrupt-controller/arm-gic.h>
    #include <dt-bindings/clock/hisilicon,hi3798mv100-crg.h>

    video-encoder@8c80000 {
        compatible = "hisilicon,hi3798mv100-venc";
        reg = <0x8c80000 0x10000>;
        interrupts = <GIC_SPI 101 IRQ_TYPE_LEVEL_HIGH>;
        clocks = <&crg HI3798MV100_VENC_CLK>;
        clock-names = "venc";
        resets = <&crg 0x8c 4>;
        reset-names = "venc";
    };
```
