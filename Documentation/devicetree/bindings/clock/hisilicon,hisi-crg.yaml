## Documentation/devicetree/bindings/sound/hisilicon,hi3798mv100-aiao-card.yaml
```yaml
# SPDX-License-Identifier: (GPL-2.0-only OR BSD-2-Clause)
%YAML 1.2
---
$id: http://devicetree.org/schemas/sound/hisilicon,hi3798mv100-aiao-card.yaml#
$schema: http://devicetree.org/meta-schemas/core.yaml#

title: HiSilicon HiSTB AIAO sound card

maintainers:
  - David Yang <mmyangfl@gmail.com>

description: |
  The sound card of the AIAO audio block. The playback link hands the
  transmit port to the HDMI transmitter; the capture link reads back the
  serial stream that same port puts on the wire.

  Nothing is on the other end of the capture link, so it has no codec,
  which is what keeps this card from being described with simple-audio-card.

  hi3716cv200 additionally drives an internal audio DAC, whose playback link
  names that codec and whose capture link taps the same transmit port the DAC
  listens to. The card driver of each SoC parses a fixed link table, so a link
  the node declares has to be one that table contains.

properties:
  compatible:
    enum:
      - hisilicon,hi3798mv100-aiao-card
      - hisilicon,hi3716cv200-aiao-card
      - hisilicon,hi3798mv200-aiao-card

  model:
    $ref: /schemas/types.yaml#/definitions/string
    description: Name reported for the sound card.

  playback:
    type: object
    description:
      DAI link carrying the audio to the HDMI transmitter.
    properties:
      cpu:
        type: object
        properties:
          sound-dai:
            $ref: /schemas/types.yaml#/definitions/phandle-array
            maxItems: 1
        required:
          - sound-dai
        additionalProperties: false
      codec:
        type: object
        properties:
          sound-dai:
            $ref: /schemas/types.yaml#/definitions/phandle-array
            maxItems: 1
        required:
          - sound-dai
        additionalProperties: false
    required:
      - cpu
      - codec
    additionalProperties: false

  capture:
    type: object
    description:
      DAI link reading the transmit port's serial stream back. It has a cpu
      and no codec.
    properties:
      cpu:
        type: object
        properties:
          sound-dai:
            $ref: /schemas/types.yaml#/definitions/phandle-array
            maxItems: 1
        required:
          - sound-dai
        additionalProperties: false
    required:
      - cpu
    additionalProperties: false

  dac-playback:
    type: object
    description:
      DAI link carrying the audio to the internal DAC (hi3716cv200). Shaped
      like playback.
    properties:
      cpu:
        type: object
        properties:
          sound-dai:
            $ref: /schemas/types.yaml#/definitions/phandle-array
            maxItems: 1
        required:
          - sound-dai
        additionalProperties: false
      codec:
        type: object
        properties:
          sound-dai:
            $ref: /schemas/types.yaml#/definitions/phandle-array
            maxItems: 1
        required:
          - sound-dai
        additionalProperties: false
    required:
      - cpu
      - codec
    additionalProperties: false

  dac-capture:
    type: object
    description:
      Tap of the line the DAC listens to, so the transmit side of that link can
      be measured with no analog probe on the board (hi3716cv200). Shaped like
      capture.
    properties:
      cpu:
        type: object
        properties:
          sound-dai:
            $ref: /schemas/types.yaml#/definitions/phandle-array
            maxItems: 1
        required:
          - sound-dai
        additionalProperties: false
    required:
      - cpu
    additionalProperties: false

required:
  - compatible
  - model
  - playback
  - capture

additionalProperties: false

examples:
  - |
    sound {
        compatible = "hisilicon,hi3798mv100-aiao-card";
        model = "hi3798mv100-hdmi";

        playback {
            cpu {
                sound-dai = <&aiao 0>;
            };
            codec {
                sound-dai = <&hdmi>;
            };
        };

        capture {
            cpu {
                sound-dai = <&aiao 1>;
            };
        };
    };
```

## Documentation/devicetree/bindings/sound/hisilicon,hi3798mv100-aiao-i2s.yaml
```yaml
# SPDX-License-Identifier: (GPL-2.0-only OR BSD-2-Clause)
%YAML 1.2
---
$id: http://devicetree.org/schemas/sound/hisilicon,hi3798mv100-aiao-i2s.yaml#
$schema: http://devicetree.org/meta-schemas/core.yaml#

title: HiSilicon Hi3798MV100 AIAO I2S ports

maintainers:
  - David Yang <mmyangfl@gmail.com>

description: |
  The Audio In And Out block of HiSilicon STB SoCs. Its ports generate their own
  bit and frame clocks (so the port is the I2S master) and move their ring buffer
  straight in or out of memory with an internal engine, which is why there is no
  dmas property here.

  The block carries the same register bands on every SoC of the family: the
  receive ports sit at +0x1000 and the transmit ports at +0x2000, each port
  taking 0x100 bytes, and the clock gate and soft reset sit in the same two bits
  of the peripheral CRG. Only the Hi3798MV100 has been run.

  On hi3798mv100 the HDMI-capable port is wired inside the SoC to the HDMI
  transmitter, so the codec side needs no phandle beyond the transmitter's own
  #sound-dai-cells. The receive port has no pins to sample on this board: the
  I2S pad mux is left in GPIO mode, so the receive port takes the serial stream
  of the transmit port instead, and captures at the rate that port plays at.

properties:
  compatible:
    const: hisilicon,hi3798mv100-aiao-i2s

  reg:
    maxItems: 1

  interrupts:
    maxItems: 1
    description: |
      Level interrupt reporting the port's buffer conditions (watermarks,
      trans_finish per TX_TRANS_SIZE bytes, overrun/underrun). Optional because
      the driver times its period boundaries itself: the trans_finish interrupt
      does not fire for a period-sized TX_TRANS_SIZE on the silicon this was
      tested on.

  clocks:
    maxItems: 1
    description: The block clock gate (PERI_CRG70 bit 0).

  resets:
    maxItems: 1
    description: The block soft reset (PERI_CRG70 bit 4).

  '#sound-dai-cells':
    const: 1
    description:
      The index of the port inside the block, counted in the order the driver
      registers its DAIs. Port 0 is the I2S transmit port wired to the HDMI
      transmitter, port 1 the receive port that taps it.

required:
  - compatible
  - reg
  - clocks
  - resets
  - '#sound-dai-cells'

additionalProperties: false

examples:
  - |
    #include <dt-bindings/clock/hisilicon,hi3798mv100-crg.h>
    #include <dt-bindings/interrupt-controller/arm-gic.h>

    audio@8cd0000 {
        compatible = "hisilicon,hi3798mv100-aiao-i2s";
        reg = <0x8cd0000 0x10000>;
        interrupts = <GIC_SPI 84 IRQ_TYPE_LEVEL_HIGH>;
        clocks = <&crg HI3798MV100_AIAO_CLK>;
        resets = <&crg 0x118 4>;
        #sound-dai-cells = <1>;
    };
```

## Documentation/devicetree/bindings/sound/hisilicon,histb-aiao-i2s.yaml
```yaml
# SPDX-License-Identifier: (GPL-2.0-only OR BSD-2-Clause)
%YAML 1.2
---
$id: http://devicetree.org/schemas/sound/hisilicon,histb-aiao-i2s.yaml#
$schema: http://devicetree.org/meta-schemas/core.yaml#

title: HiSilicon STB AIAO I2S transmit port

maintainers:
  - David Yang <mmyangfl@gmail.com>

description: |
  The Audio In And Out block of HiSilicon STB SoCs. Its transmit ports
  generate their own bit and frame clocks (so the port is the I2S master)
  and feed the ring buffer straight out of memory with an internal engine,
  which is why there is no dmas property here.

  On hi3798mv100 the HDMI-capable port is wired inside the SoC to the HDMI
  transmitter, so the codec side needs no phandle beyond the transmitter's
  own #sound-dai-cells.

properties:
  compatible:
    const: hisilicon,histb-aiao-i2s

  reg:
    maxItems: 1

  interrupts:
    maxItems: 1
    description: |
      Level interrupt reporting the port's buffer conditions (watermarks,
      trans_finish per TX_TRANS_SIZE bytes, overrun/underrun).  Optional because
      the driver times its period boundaries itself: the trans_finish interrupt
      does not fire for a period-sized TX_TRANS_SIZE on the silicon this was
      tested on.

  clocks:
    maxItems: 1
    description: The block clock gate (PERI_CRG70 bit 0).

  resets:
    maxItems: 1
    description: The block soft reset (PERI_CRG70 bit 4).

  '#sound-dai-cells':
    const: 0

required:
  - compatible
  - reg
  - clocks
  - resets
  - '#sound-dai-cells'

additionalProperties: false

examples:
  - |
    #include <dt-bindings/clock/hisilicon,hi3798mv100-crg.h>
    #include <dt-bindings/interrupt-controller/arm-gic.h>

    audio@8cd0000 {
        compatible = "hisilicon,histb-aiao-i2s";
        reg = <0x8cd0000 0x10000>;
        interrupts = <GIC_SPI 84 IRQ_TYPE_LEVEL_HIGH>;
        clocks = <&crg HI3798MV100_AIAO_CLK>;
        resets = <&crg 0x118 4>;
        #sound-dai-cells = <0>;
    };
```

## Documentation/devicetree/bindings/timer/hisilicon,hi3716cv200-smp-timer.yaml
```yaml
# SPDX-License-Identifier: (GPL-2.0-only OR BSD-2-Clause)
%YAML 1.2
---
$id: http://devicetree.org/schemas/timer/hisilicon,hi3716cv200-smp-timer.yaml#
$schema: http://devicetree.org/meta-schemas/core.yaml#

title: HiSilicon Hi3716CV200 per-CPU SP804 local timers

maintainers:
  - David Yang <mmyangfl@gmail.com>

description: |
  Hi3716CV200 has no usable Cortex-A9 local timer: neither the private timer and
  watchdog block nor the global timer in the A9 MPCore private region counts, so
  the per-CPU clock events come from dedicated SP804 channels -- cell 4 for the
  first CPU and cell 6 for the second, each with its own interrupt line.

  These channels are separate from the arm,sp804 node that provides the
  clocksource and the broadcast clock event, which remains the fallback for a
  CPU with no channel of its own.

properties:
  compatible:
    const: hisilicon,hi3716cv200-smp-timer

  reg:
    minItems: 1
    maxItems: 8
    description:
      One entry per CPU, listed in CPU order; each is that CPU's SP804 channel.

  interrupts:
    minItems: 1
    maxItems: 8
    description:
      One entry per CPU, in the same order as reg.

  clocks:
    maxItems: 1

required:
  - compatible
  - reg
  - interrupts
  - clocks

additionalProperties: false

examples:
  - |
    #include <dt-bindings/interrupt-controller/arm-gic.h>

    timer@f8a2a000 {
        compatible = "hisilicon,hi3716cv200-smp-timer";
        reg = <0xf8a2a000 0x20>, <0xf8a2b000 0x20>;
        interrupts = <GIC_SPI 26 IRQ_TYPE_LEVEL_HIGH>,
                     <GIC_SPI 27 IRQ_TYPE_LEVEL_HIGH>;
        clocks = <&xtal24mhz>;
    };
```

## drivers/gpu/drm/histb/Kconfig
```kconfig
# SPDX-License-Identifier: GPL-2.0-or-later OR MIT
config DRM_HISTB_VDP2
	tristate "DRM Support for HiSTB VDP v2 display engine"
	depends on DRM && OF && ARM
	select DRM_GEM_DMA_HELPER
	select DRM_KMS_HELPER
	select DRM_DISPLAY_HELPER
	select DRM_BRIDGE_CONNECTOR
	select DRM_CLIENT_SELECTION
	help
	  Choose this option for DRM support for the VDP v2 display engine found
	  on HiSilicon HiSTB SoCs such as the hi3798mv100 and the hi3796mv100.
	  It exposes one CRTC with a primary plane and sends its output to the
	  HDMI transmitter selected through the device tree of_graph port@0
	  endpoint.

	  If in doubt, say N.

config DRM_HISTB_VDP4
	tristate "DRM Support for HiSTB VDP v4 display engine"
	depends on DRM && OF && ARM64
	select MFD_SYSCON
	select DRM_GEM_DMA_HELPER
	select DRM_KMS_HELPER
	select DRM_DISPLAY_HELPER
	select DRM_BRIDGE_CONNECTOR
	select DRM_CLIENT_SELECTION
	help
	  Choose this option for DRM support for the VDP v4 display engine found
	  on HiSilicon HiSTB SoCs such as the hi3798mv200. It exposes one CRTC with
	  a primary plane and sends its output to the display interface selected
	  through the device tree of_graph port@0 endpoint.

	  If in doubt, say N.

config DRM_HISTB_HDMI
	tristate "DRM support for the HiSTB on-chip HDMI transmitter"
	depends on DRM && I2C && OF && ARM64
	select MFD_SYSCON
	select SND_SOC_HDMI_CODEC if SND_SOC
	help
	  Choose this option for the on-chip HDMI 2.0 transmitter of HiSilicon
	  HiSTB SoCs such as the hi3798mv200. It is the bridge downstream of a
	  VDP display channel and turns that channel's pixel stream into a TMDS
	  link.

	  If in doubt, say N.
```

## drivers/media/platform/hisilicon/Kconfig
```kconfig
# SPDX-License-Identifier: GPL-2.0-or-later OR MIT

comment "HiSilicon media platform drivers"

source "drivers/media/platform/hisilicon/histb-vdec/Kconfig"

config VIDEO_HISTB_JPGD
	tristate "HiSilicon HiSTB JPEG decoder driver"
	depends on ARCH_HISI || COMPILE_TEST
	depends on V4L_MEM2MEM_DRIVERS
	depends on VIDEO_DEV
	select VIDEOBUF2_DMA_CONTIG
	select V4L2_MEM2MEM_DEV
	select V4L2_JPEG_HELPER
	help
	  Support for the JPGD hardware JPEG decoder on HiSilicon Hi3798MV100
	  and Hi3716CV200 set-top-box SoCs. The driver parses the baseline JPEG
	  header in the
	  kernel, expands the quantiser and Huffman tables into the forms the
	  block expects, and decodes one picture per mem2mem job into 8-bit
	  semi-planar YUV.

	  To compile this driver as a module, choose M here: the module will be
	  called histb-jpgd.

config VIDEO_HISTB_JPGE
	tristate "HiSilicon HiSTB JPEG encoder driver"
	depends on ARCH_HISI || COMPILE_TEST
	depends on V4L_MEM2MEM_DRIVERS
	depends on VIDEO_DEV
	select VIDEOBUF2_DMA_CONTIG
	select V4L2_MEM2MEM_DEV
	select V4L2_JPEG_HELPER
	help
	  Support for the JPGE hardware JPEG encoder on HiSilicon Hi3798MV100
	  and Hi3716CV200 set-top-box SoCs. The driver scales the standard
	  quantiser tables for
	  the requested quality, writes the JFIF header the block does not
	  produce itself, and encodes one 8-bit semi-planar picture per mem2mem
	  job.

	  To compile this driver as a module, choose M here: the module will be
	  called histb-jpge.

config VIDEO_HISTB_VENC
	tristate "HiSilicon HiSTB H.264 encoder driver"
	depends on ARCH_HISI || COMPILE_TEST
	depends on V4L_MEM2MEM_DRIVERS
	depends on VIDEO_DEV
	select VIDEOBUF2_DMA_CONTIG
	select V4L2_MEM2MEM_DEV
	help
	  Support for the VEDU hardware H.264 encoder on HiSilicon Hi3798MV100
	  and Hi3716CV200 set-top-box SoCs. The driver encodes one 8-bit
	  semi-planar picture per mem2mem job as an IDR frame with CAVLC, writes
	  the sequence and picture
	  parameter sets and the slice header the block does not produce itself,
	  and reads the coded packets back out of the ring buffer it programs.

	  To compile this driver as a module, choose M here: the module will be
	  called histb-venc.
```

## drivers/media/platform/hisilicon/histb-vdec/Kconfig
```kconfig
# SPDX-License-Identifier: GPL-2.0-or-later OR MIT
config VIDEO_HISTB_VDEC
	tristate "HiSilicon HiSTB video decoder driver"
	depends on ARCH_HISI || COMPILE_TEST
	depends on V4L_MEM2MEM_DRIVERS
	depends on VIDEO_DEV
	select VIDEOBUF2_DMA_CONTIG
	select V4L2_MEM2MEM_DEV
	select V4L2_H264
	help
	  Support for the VDH hardware video decoder on HiSilicon Hi3798MV100
	  and Hi3716CV200 set-top-box SoCs. The driver implements the V4L2
	  stateless decoder interface: the bitstream is parsed in userspace and
	  submitted through request controls, and the hardware decodes H.264,
	  HEVC, MPEG-2, MPEG-4 and H.263 into 16x16-tiled NV21 frames. The
	  Hi3716CV200's generation of the block has no HEVC path, so that
	  profile is only negotiable on Hi3798MV100.

	  To compile this driver as a module, choose M here: the module will be
	  called histb-vdec.
```
