## sound/soc/hisilicon/Kconfig
```kconfig
# SPDX-License-Identifier: GPL-2.0-only
menu "Hisilicon"

config SND_I2S_HI6210_I2S
	tristate "Hisilicon I2S controller"
	select SND_SOC_GENERIC_DMAENGINE_PCM
	help
	  Hisilicon I2S

config SND_SOC_HISTB_AIAO_I2S
	tristate "HiSTB AIAO I2S ports"
	depends on ARCH_HISI || COMPILE_TEST
	select SND_SOC_GENERIC_DMAENGINE_PCM
	help
	  Say Y here if you want to use the I2S ports of the AIAO audio block
	  found on HiSilicon STB SoCs such as the Hi3798MV100, the Hi3716CV200
	  and the Hi3798MV200. Each port is an I2S master with its own clock
	  generator and its own ring-buffer engine, and on these boards the
	  transmit port wired to the HDMI transmitter is what carries its
	  audio. The receive port taps the serial stream of that transmit port
	  back in.

config SND_SOC_HISTB_ADAC
	tristate "HiSTB TianLai internal audio DAC"
	depends on ARCH_HISI || COMPILE_TEST
	help
	  Say Y here if you want the on-chip analog output stage of HiSilicon
	  STB SoCs such as the Hi3716CV200. It is an I2S consumer with no
	  selectable data source: the vendor port map wires it to AIAO transmit
	  port 2, and it has no capture side in the V500 generation this part
	  builds with.

config SND_SOC_HISTB_AIAO_CARD
	tristate "HiSTB AIAO Sound Card"
	depends on ARCH_HISI || COMPILE_TEST
	select SND_SOC_HISTB_AIAO_I2S
	help
	  Say Y here if you want the sound card of the AIAO audio block on
	  HiSilicon STB SoCs: the playback link hands the transmit port to the
	  HDMI transmitter, and the capture link reads back the serial stream
	  that same port puts on the wire. Nothing sits behind the capture
	  side, which is what keeps it from simple-audio-card.

endmenu
```
